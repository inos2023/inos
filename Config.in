## Config.in
```kconfig
menu "INOS Config"
source "$BR2_EXTERNAL_INOS_PATH/package/Config.in"
source "$BR2_EXTERNAL_INOS_PATH/linux/driver/Config.in"

config INOS_TEST
  bool "test"
  default y
  select BR2_PACKAGE_GTEST
  help
    开启后会编译单元测试相关的内容。



endmenu
```

## package/Config.in
```kconfig
source "$BR2_EXTERNAL_INOS_PATH/package/apps/Config.in"
source "$BR2_EXTERNAL_INOS_PATH/package/frameworks/Config.in"
source "$BR2_EXTERNAL_INOS_PATH/package/sdk/Config.in"
source "$BR2_EXTERNAL_INOS_PATH/package/services/Config.in"
source "$BR2_EXTERNAL_INOS_PATH/package/toolkit/Config.in"
```

## package/apps/Config.in
```kconfig
menu "Application Config"
    source "$BR2_EXTERNAL_INOS_PATH/package/apps/inos_flow/Config.in"
    source "$BR2_EXTERNAL_INOS_PATH/package/apps/demo/Config.in"
endmenu
```

## package/apps/demo/Config.in
```kconfig
config BR2_PACKAGE_DEMO
  bool "demo"
  default y
  depends on BR2_INSTALL_LIBSTDCPP
  select BR2_PACKAGE_GLOG
  select BR2_PACKAGE_OPENCV3
  select BR2_PACKAGE_AIRUNTIME
  select BR2_PACKAGE_BASE_RUNTIME
  select BR2_PACKAGE_MEDIA_RUNTIME
  select BR2_PACKAGE_INOS_SDK
  depends on BR2_PACKAGE_CAMBRICON_V2_ARM64_TOOLKIT \
	|| BR2_PACKAGE_CAMBRICON_V2_X86_64_TOOLKIT
  help
    This is inos demo.

comment "demo needs a toolchain C++"
	depends on !BR2_INSTALL_LIBSTDCPP   
```

## package/apps/inos_flow/Config.in
```kconfig
config BR2_PACKAGE_INOSFLOW
  bool "inos_flow"
  default y
  depends on BR2_INSTALL_LIBSTDCPP
  select BR2_PACKAGE_GLOG
  select BR2_PACKAGE_JSON_FOR_MODERN_CPP
  select BR2_PACKAGE_AIRUNTIME
  select BR2_PACKAGE_BASE_RUNTIME
  select BR2_PACKAGE_MEDIA_RUNTIME
  help
    This is inos flow.

comment "inos flow needs a toolchain C++"
	depends on !BR2_INSTALL_LIBSTDCPP   
```

## package/frameworks/Config.in
```kconfig
menu "Frameworks Config"
    source "$BR2_EXTERNAL_INOS_PATH/package/frameworks/common/Config.in"
    source "$BR2_EXTERNAL_INOS_PATH/package/frameworks/airuntime/Config.in"
    source "$BR2_EXTERNAL_INOS_PATH/package/frameworks/hal/Config.in"
    source "$BR2_EXTERNAL_INOS_PATH/package/frameworks/hardware/Config.in"
    source "$BR2_EXTERNAL_INOS_PATH/package/frameworks/hal/Config.in"
    source "$BR2_EXTERNAL_INOS_PATH/package/frameworks/base_runtime/Config.in"
    source "$BR2_EXTERNAL_INOS_PATH/package/frameworks/media_runtime/Config.in"

endmenu
```

## package/frameworks/airuntime/Config.in
```kconfig
config BR2_PACKAGE_AIRUNTIME
  bool "airuntime"
  default y
  depends on BR2_PACKAGE_HOST_RUSTC_TARGET_ARCH_SUPPORTS
  select BR2_PACKAGE_HOST_RUSTC
  select BR2_PACKAGE_GLOG
  select BR2_PACKAGE_INOS_BASE
  select BR2_PACKAGE_AI_CHIP
  help
    This is a airuntime package for cargo.

comment "airuntime needs a toolchain C++"
	depends on !BR2_INSTALL_LIBSTDCPP   
```

## package/frameworks/base_runtime/Config.in
```kconfig
config BR2_PACKAGE_BASE_RUNTIME
  bool "base_runtime"
  default y
  depends on BR2_INSTALL_LIBSTDCPP
  select BR2_PACKAGE_GLOG
  select BR2_PACKAGE_DBUS
  select BR2_PACKAGE_JSON_FOR_MODERN_CPP
  help
    This is base runtime module.

comment "base runtime needs a toolchain C++"
	depends on !BR2_INSTALL_LIBSTDCPP   
```

## package/frameworks/common/Config.in
```kconfig
menu "Common Config"
    source "$BR2_EXTERNAL_INOS_PATH/package/frameworks/common/inos_base/Config.in"
endmenu
```

## package/frameworks/common/inos_base/Config.in
```kconfig
config BR2_PACKAGE_INOS_BASE
  bool "inos_base"
  default y
  help
    This is base module in framework.
```

## package/frameworks/common/osal/Config.in
```kconfig
config BR2_PACKAGE_COMMON_OSAL
  bool "osal"
  help
    This is OSAL module in framework.
```

## package/frameworks/hal/Config.in
```kconfig
menu "HAL Config"
    source "$BR2_EXTERNAL_INOS_PATH/package/frameworks/hal/hal/Config.in"
    source "$BR2_EXTERNAL_INOS_PATH/package/frameworks/hal/modules/Config.in"
endmenu
```

## package/frameworks/hal/hal/Config.in
```kconfig
config BR2_PACKAGE_HAL
  bool "hal"
  default y
  depends on BR2_INSTALL_LIBSTDCPP
  select BR2_PACKAGE_GLOG
  help
    This is HAL module.

comment "hal needs a toolchain C++"
	depends on !BR2_INSTALL_LIBSTDCPP   
```

## package/frameworks/hal/modules/Config.in
```kconfig
menu "Modules Config"
    source "$BR2_EXTERNAL_INOS_PATH/package/frameworks/hal/modules/ai_chip/Config.in"
endmenu
```

## package/frameworks/hal/modules/ai_chip/Config.in
```kconfig
config BR2_PACKAGE_AI_CHIP
  bool "ai_chip"
  default y
  depends on BR2_INSTALL_LIBSTDCPP
  select BR2_PACKAGE_GLOG
  select BR2_PACKAGE_HAL
  select BR2_PACKAGE_INOS_BASE
  select BR2_PACKAGE_GTEST if INOS_TEST
  select BR2_PACKAGE_GTEST_GMOCK if INOS_TEST
  help
    This is a  AIChip module for HAL.

comment "ai_chip needs a toolchain C++"
	depends on !BR2_INSTALL_LIBSTDCPP
```

## package/frameworks/hardware/Config.in
```kconfig
menu "HARDWARE Config"
    source "$BR2_EXTERNAL_INOS_PATH/package/frameworks/hardware/vendors/Config.in"
endmenu
```

## package/frameworks/hardware/vendors/Config.in
```kconfig
menu "Vendors Config"
    source "$BR2_EXTERNAL_INOS_PATH/package/frameworks/hardware/vendors/cambricon_mlu/Config.in"
endmenu
```

## package/frameworks/hardware/vendors/cambricon_mlu/Config.in
```kconfig
config BR2_PACKAGE_CAMBRICON_MLU
  bool "cambricon_mlu"
  depends on BR2_INSTALL_LIBSTDCPP
  select BR2_PACKAGE_GLOG
  select BR2_PACKAGE_INOS_BASE
  depends on BR2_PACKAGE_AI_CHIP
  default n
  help
    This is a cambricon_mlu module for HAL.
comment "cambricon_mlu needs a toolchain C++"
	depends on !BR2_INSTALL_LIBSTDCPP

if BR2_PACKAGE_CAMBRICON_MLU

config BR2_PACKAGE_CAMBRICON_MLU_BASE_DEVICE
    bool "cambricon_mlu_base"
    default n
    help
      Build the cambricon mlu base .so.

config BR2_PACKAGE_CAMBRICON_MLU_NN_DEVICE
    bool "cambricon_mlu_nn_device"
    default n
    help
      Build the cambricon mlu nn device .so.

config BR2_PACKAGE_CAMBRICON_MLU_MEDIA
    bool "cambricon_mlu_media"
    default n
    help
      Build the cambricon mlu media .so.

endif

if BR2_PACKAGE_CAMBRICON_MLU_NN_DEVICE
config BR2_PACKAGE_CAMBRICON_MLU_NN_DEVICE_CNNL
    bool "cambricon_mlu_cnnl"
    default n
    help
      use cambricon mlu nn device by cnnl
endif
```

## package/frameworks/media_runtime/Config.in
```kconfig
config BR2_PACKAGE_MEDIA_RUNTIME
  bool "media_runtime"
  default y
  depends on BR2_INSTALL_LIBSTDCPP
  select BR2_PACKAGE_GLOG
  depends on BR2_PACKAGE_AI_CHIP
  help
    This is media runtime module.

comment "media runtime needs a toolchain C++"
	depends on !BR2_INSTALL_LIBSTDCPP   
```

## package/sdk/Config.in
```kconfig
menu "SDK Config"
    source "$BR2_EXTERNAL_INOS_PATH/package/sdk/inos_sdk/Config.in"
endmenu
```

## package/sdk/inos_sdk/Config.in
```kconfig
config BR2_PACKAGE_INOS_SDK
  bool "inos_sdk"
  default y
  depends on BR2_INSTALL_LIBSTDCPP
  select BR2_PACKAGE_GLOG
  select BR2_PACKAGE_OPENCV3
  help
    This is inos sdk.

comment "inos sdk needs a toolchain C++"
	depends on !BR2_INSTALL_LIBSTDCPP   
```

## package/services/Config.in
```kconfig
menu "Services Config"
    source "$BR2_EXTERNAL_INOS_PATH/package/services/device_manager/Config.in"
    source "$BR2_EXTERNAL_INOS_PATH/package/services/service-1/Config.in"
endmenu
```

## package/services/device_manager/Config.in
```kconfig
config BR2_PACKAGE_DEVICE_MANAGER
  bool "device_manager"
  default y
  depends on BR2_PACKAGE_HOST_RUSTC_TARGET_ARCH_SUPPORTS
  select BR2_PACKAGE_HOST_RUSTC
  help
    This is a device manager for devices.
```
